## boards/udoo/udoo_key_rp2040/Kconfig
```kconfig
# Copyright (c) 2026 Mohan Nagaraj
# SPDX-License-Identifier: Apache-2.0

config BOARD_UDOO_KEY_RP2040
	select RP2_FLASH_W25Q080
```

## boards/udoo/udoo_key_rp2040/board.yml
```yaml
board:
  name: udoo_key_rp2040
  full_name: UDOO KEY RP2040
  vendor: udoo
  socs:
    - name: rp2040
```
